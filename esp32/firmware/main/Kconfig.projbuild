## esp32/firmware/main/Kconfig.projbuild
```kconfig
menu "tinyasr"
    choice TASR_MODE
        prompt "Input source"
        default TASR_MODE_FILE
        config TASR_MODE_FILE
            bool "Benchmark: utterances stored in the 'audio' partition"
        config TASR_MODE_MIC
            bool "Live: I2S MEMS microphone (e.g. INMP441)"
    endchoice
    config TASR_I2S_BCLK
        int "I2S BCLK (SCK) GPIO"
        default 4
    config TASR_I2S_WS
        int "I2S WS (LRCL) GPIO"
        default 5
    config TASR_I2S_DIN
        int "I2S data-in (SD) GPIO"
        default 6
    config TASR_USB_HID
        bool "USB HID dictation keyboard (native USB, US layout)"
        default n
        depends on TASR_MODE_MIC && IDF_TARGET_ESP32S3
        help
            Use sdkconfig.usb_hid or TASR_USB_HID=1 tools/flash.sh to also
            configure TinyUSB. Starts paused; BOOT toggles dictation. Text is
            typed into the focused application with a space, never Enter.
    config TASR_USB_BUTTON_GPIO
        int "Active-low dictation toggle GPIO (BOOT = 0)"
        range 0 48
        default 0
        depends on TASR_USB_HID
    config TASR_USB_LED_GPIO
        int "Optional active-high armed LED GPIO (-1 disables)"
        range -1 48
        default -1
        depends on TASR_USB_HID
        help
            Use an ordinary external LED plus resistor, not an addressable RGB LED.
            GPIO7 is free with the default microphone/OLED wiring.
    config TASR_USB_REPORT_INTERVAL_MS
        int "Minimum interval between USB key press/release reports (ms)"
        range 10 100
        default 10
        depends on TASR_USB_HID
    config TASR_OLED
        bool "SSD1306 128x64 I2C OLED showing the live transcript"
        default n
    config TASR_OLED_SDA
        int "OLED SDA GPIO"
        default 8
        depends on TASR_OLED
    config TASR_OLED_SCL
        int "OLED SCL GPIO"
        default 9
        depends on TASR_OLED
    config TASR_OLED_ADDR
        hex "OLED I2C address"
        default 0x3C
        depends on TASR_OLED
    config TASR_CHUNK
        int "Encoder chunk (25 Hz frames, even); 32 = 1.28 s"
        default 32
    config TASR_LEFT
        int "Attention history in chunks"
        default 2
    config TASR_MAX_UTTERANCE_SECONDS
        int "Maximum NeMo utterance seconds (workspace and decoder capacity)"
        range 1 20
        default 20
    config TASR_UTTERANCE_BUFFERS
        int "Live utterance buffers (recording + queued/inference)"
        range 2 4
        default 3
    config TASR_INFERENCE_TAIL_MS
        int "Experimental inference silence tail in ms (-1 keeps all)"
        range -1 820
        default -1
        help
            Does not shorten the endpoint wait. A shorter inference slice changes
            utterance normalization and therefore requires WER validation.
    config TASR_NEMO_FLOAT_STATS
        bool "Experimental single-precision feature statistics"
        default n
        help
            Uses the ESP32-S3 FPU for normalization statistics; changes arithmetic.
            Leave disabled until recognition accuracy has been revalidated.
    config TASR_PAR_MIN_WORK
        int "Minimum estimated scalar work for a parallel dispatch (0 preserves all)"
        range 0 1000000
        default 0
        help
            Hardware-tunable threshold. Small jobs run on the calling core.
    config TASR_BEAM
        int "Beam width when an LM partition is present"
        range 1 16
        default 4
    config TASR_LM_WEIGHT_X100
        int "LM weight x100"
        default 60
    config TASR_TOKEN_BONUS_X100
        int "Token insertion bonus x100"
        default 250
endmenu
```
